
/dts-v1/;

#include "atb-rk3568j-smc.dts"

&gmac1 {
	phy-mode = "rgmii";
	clock_in_out = "output";

	assigned-clocks = <&cru SCLK_GMAC1_RX_TX>, <&cru SCLK_GMAC1>, <&cru CLK_MAC1_OUT>;
	assigned-clock-parents = <&cru SCLK_GMAC1_RGMII_SPEED>;
	assigned-clock-rates = <0>, <125000000>, <25000000>;

	pinctrl-names = "default";
	pinctrl-0 = <&gmac1m0_tx_bus2
			&gmac1m0_rx_bus2
			&gmac1m0_rgmii_clk
			&gmac1m0_rgmii_bus
			&eth1m0_pins
			&gmac1m0_clkinout
			&rgmii_phy1_reset_pin>;

	status = "okay";
};
