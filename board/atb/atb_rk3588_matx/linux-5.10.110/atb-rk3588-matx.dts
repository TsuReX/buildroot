// SPDX-License-Identifier: (GPL-2.0+ OR MIT)
/*
 * Copyright (c) 2022 Rockchip Electronics Co., Ltd.
 * Copyright (c) 2022 Radxa Limited
 *
 */

/dts-v1/;

#include <dt-bindings/gpio/gpio.h>
#include <dt-bindings/leds/common.h>
#include <dt-bindings/pwm/pwm.h>
#include <dt-bindings/pinctrl/rockchip.h>
#include <dt-bindings/input/rk-input.h>
#include <dt-bindings/display/drm_mipi_dsi.h>
#include <dt-bindings/display/rockchip_vop.h>
#include <dt-bindings/sensor-dev.h>
#include "dt-bindings/usb/pd.h"
#include "rockchip/rk3588.dtsi"

/ {
	model = "ATB RK3588 MATX";
	compatible = "atb,rk3588-matx", "rockchip,rk3588";

    aliases {
		ethernet0 = &gmac0;
		ethernet1 = &gmac1;
        mmc0 = &sdhci;
		mmc1 = &sdmmc;
	};
	
    chosen: chosen {
		bootargs = "earlycon=uart8250,mmio32,0xfeb50000 console=ttyFIQ0";
		stdout-path = "serial2:115200n8";
	};

    //DEBUG ON UART2
    fiq_debugger: fiq-debugger {
		compatible = "rockchip,fiq-debugger";
		rockchip,serial-id = <2>;
		rockchip,wake-irq = <0>;
		//If enable uart uses irq instead of fiq
		rockchip,irq-mode-enable = <1>;
		rockchip,baudrate = <115200>;  // Only 115200 and 1500000
		interrupts = <GIC_SPI 423 IRQ_TYPE_LEVEL_LOW>;
		pinctrl-names = "default";
		pinctrl-0 = <&uart2m0_xfer>;
		status = "okay";
	};
	
    cspmu: cspmu@fd10c000 {
		compatible = "rockchip,cspmu";
		reg = <0x0 0xfd10c000 0x0 0x1000>,
		      <0x0 0xfd10d000 0x0 0x1000>,
		      <0x0 0xfd10e000 0x0 0x1000>,
		      <0x0 0xfd10f000 0x0 0x1000>,
		      <0x0 0xfd12c000 0x0 0x1000>,
		      <0x0 0xfd12d000 0x0 0x1000>,
		      <0x0 0xfd12e000 0x0 0x1000>,
		      <0x0 0xfd12f000 0x0 0x1000>;
	};

	debug: debug@fd104000 {
		compatible = "rockchip,debug";
		reg = <0x0 0xfd104000 0x0 0x1000>,
		      <0x0 0xfd105000 0x0 0x1000>,
		      <0x0 0xfd106000 0x0 0x1000>,
		      <0x0 0xfd107000 0x0 0x1000>,
		      <0x0 0xfd124000 0x0 0x1000>,
		      <0x0 0xfd125000 0x0 0x1000>,
		      <0x0 0xfd126000 0x0 0x1000>,
		      <0x0 0xfd127000 0x0 0x1000>;
	};
	
    firmware {
		optee: optee {
			compatible = "linaro,optee-tz";
			method = "smc";
			//status = "disabled";
		};
	};
	
	
	//Input suply
	vcc12v_dcin: vcc12v-dcin {
		compatible = "regulator-fixed";
		regulator-name = "vcc12v_dcin";
		regulator-always-on;
		regulator-boot-on;
		regulator-min-microvolt = <12000000>;
		regulator-max-microvolt = <12000000>;
	};
	
    //D6
	vcc4v0_sys: vcc4v0-sys {
		compatible = "regulator-fixed";
		regulator-name = "vcc4v0_sys";
		regulator-always-on;
		regulator-boot-on;
		regulator-min-microvolt = <4000000>;
		regulator-max-microvolt = <4000000>;
		vin-supply = <&vcc12v_dcin>;
	};
	
	//D7-1
	vcc5v0: vcc5v0 {
		compatible = "regulator-fixed";
		regulator-name = "vcc5v0";
		regulator-always-on;
		regulator-boot-on;
		regulator-min-microvolt = <5000000>;
		regulator-max-microvolt = <5000000>;
		vin-supply = <&vcc12v_dcin>;
	};
	//D7-2
	vcc3v3: vcc3v3 {
		compatible = "regulator-fixed";
		regulator-name = "vcc3v3";
		regulator-always-on;
		regulator-boot-on;
		regulator-min-microvolt = <3300000>;
		regulator-max-microvolt = <3300000>;
		vin-supply = <&vcc12v_dcin>;
	};
	
    //D5
    vcc_1v1_nldo_s3: vcc-1v1-nldo-s3 {
		compatible = "regulator-fixed";
		regulator-name = "vcc_1v1_nldo_s3";
		regulator-always-on;
		regulator-boot-on;
		regulator-min-microvolt = <1100000>;
		regulator-max-microvolt = <1100000>;
		vin-supply = <&vcc4v0_sys>;
	};
	
	//D13
    eMMc_FSPI_Mux: eMMc-FSPI-Mux {
		compatible = "regulator-fixed";
		regulator-name = "eMMc_FSPI_Mux";
		regulator-always-on;
		regulator-boot-on;
		enable-active-high;
		//FSPI
		//gpios = <&gpio4 RK_PB4 GPIO_ACTIVE_LOW>;
		//eMMC
		gpios = <&gpio4 RK_PB4 GPIO_ACTIVE_HIGH>;
		vin-supply = <&vcc3v3>;
	};

	//D16
	//EN_USB2_0_PWR
    usb2_0_vcc: usb2_0_vcc {
        compatible = "regulator-fixed";
        regulator-name = "en_usb2_0_vcc";
        regulator-boot-on;
        regulator-always-on;
        enable-active-high;
        gpios = <&gpio1 RK_PA4 GPIO_ACTIVE_HIGH>;
        vin-supply = <&vcc5v0>;
        status = "okay";
    };
    
    //D17
    //EN_USB3_0_PWR
    usb3_0_vcc: usb3_0_vcc {
        compatible = "regulator-fixed";
        regulator-name = "en_usb3_0_vcc";
        regulator-boot-on;
        regulator-always-on;
        enable-active-high;
        gpios = <&gpio4 RK_PB0 GPIO_ACTIVE_HIGH>;
        vin-supply = <&vcc5v0>;
        status = "okay";
    };
    
    //D18
    //EN_USB3_1_PWR
    usb3_1_vcc: usb3_1_vcc {
        compatible = "regulator-fixed";
        regulator-name = "en_usb3_1_vcc";
        regulator-boot-on;
        regulator-always-on;
        enable-active-high;
        gpios = <&gpio4 RK_PA4 GPIO_ACTIVE_HIGH>;
        vin-supply = <&vcc5v0>;
        status = "okay";
    };
    
    //D19 //D20
    //USBHUB_RSTn
    usbhub_rstn: usbhub_rstn {
        compatible = "regulator-fixed";
        regulator-name = "usbhub_rstn";
        regulator-boot-on;
        regulator-always-on;
        enable-active-high;
        gpios = <&gpio1 RK_PB4 GPIO_ACTIVE_HIGH>;
        vin-supply = <&vcc_3v3>;
        status = "okay";
    };
    
    //D21 USBHUB0_PWR //Always enable
    //D22 USBHUB1_PWR //Always enable
    
    //CHECK_IT //Как это работает?
    //D23 M2kB_PCIE_CFG1 //Автовыбор
    //D24 M2kB_PCIE_CFG1 //Автовыбор
    
    //D25
    miniPCIe_1_5v: miniPCIe_1_5v {
		compatible = "regulator-fixed";
		regulator-name = "vcc_miniPCIe_1_5v";
		regulator-always-on;
		regulator-boot-on;
		regulator-min-microvolt = <1500000>;
		regulator-max-microvolt = <1500000>;
		vin-supply = <&vcc3v3>;
	};
	
	//D39 //D40
	//CHECK_IT //TEST
	/*
	watchdog {
        compatible = "linux,wdt-gpio";
		pinctrl-names = "default";
		pinctrl-0 = <&pinctrl_watchdog_gpio>;
		always-running;
		gpios = <&gpio4 RK_PA7 GPIO_ACTIVE_HIGH>;
		hw_algo = "toggle";
		// Reset triggers in 2..3 seconds 
		hw_margin_ms = <700>;
		// Disabled by default 
		status = "disabled";
	};
	*/
	
    sound {
		compatible = "audio-graph-card";
		label = "rockchip,es8388-codec";
		widgets = "Microphone", "Mic Jack",
			  "Headphone", "Headphones";
		routing = "LINPUT2", "Mic Jack",
			  "Headphones", "LOUT1",
			  "Headphones", "ROUT1";
		dais = <&i2s0_8ch_p0>;
	};
	
    sdio_pwrseq: sdio-pwrseq {
		compatible = "mmc-pwrseq-simple";
		clocks = <&rtc_clock>; // <----------------------------------!!!
		clock-names = "ext_clock"; // <----------------------------------!!!
		pinctrl-names = "default";
		pinctrl-0 = <&wlan_en_pin>;

		//post-power-on-delay-ms = <200>;   //CHECK_IT
		// SDMMC_PWREN_
		reset-gpios = <&gpio4 RK_PA5 GPIO_ACTIVE_LOW>;
	};
	
    //D45
    //mPCIE_m2_SEL  //ВХОД! Рулится джампером X37
    /*
    PciE20_1_Sata_Mux: PciE20_1_Sata_Mux {
		compatible = "regulator-fixed";
		regulator-name = "PciE20_1_Sata_Mux";
		regulator-always-on;
		regulator-boot-on;
		enable-active-high;
		//SATA mPcie Slot
		//gpios = <&gpio4 RK_PB1 GPIO_ACTIVE_LOW>;
		//Sata M.2 E Slot
		gpios = <&gpio4 RK_PB1 GPIO_ACTIVE_HIGH>;
		vin-supply = <&vcc3v3>;
	};
	*/

    // Pcie host power.
	PCIE_EXT_PWREN_: PCIE_EXT_PWREN_ {
		compatible = "regulator-fixed";
		regulator-name = "PCIE_EXT_PWREN_";
		regulator-boot-on;
		regulator-always-on;
		enable-active-low;
		gpios = <&gpio1 RK_PB3 GPIO_ACTIVE_HIGH>;
		vin-supply = <&vcc4v0_sys>;
		status = "okay";
	};
	
	// Pcie host clock.
	PCIE_x4_CLK_ENA_: PCIE_x4_CLK_ENA_ {
		compatible = "regulator-fixed";
		regulator-name = "PCIE_x4_CLK_ENA_";
		regulator-boot-on;
		regulator-always-on;
		enable-active-high;
		gpios = <&gpio4 RK_PA2 GPIO_ACTIVE_HIGH>;
		vin-supply = <&vcc4v0_sys>;
		status = "okay";
	};
	// Pcie host clock.
	PCIE30_CPU_CLK_ENA_: PCIE30_CPU_CLK_ENA_ {
		compatible = "regulator-fixed";
		regulator-name = "PCIE30_CPU_CLK_ENA_";
		regulator-boot-on;
		regulator-always-on;
		enable-active-high;
		gpios = <&gpio4 RK_PA0 GPIO_ACTIVE_HIGH>;
		vin-supply = <&vcc4v0_sys>;
		status = "okay";
	};
	
    // Pcie reset.
	PCIe_RST_: PCIe-RST- {
		compatible = "regulator-fixed";
		regulator-name = "PCIe_RST_";
		regulator-boot-on;
		regulator-always-on;
		enable-active-high;
		gpios = <&gpio1 RK_PB2 GPIO_ACTIVE_HIGH>;
		vin-supply = <&vcc4v0_sys>;
		status = "okay";
	};
	
	//X21
	//m.2 and miniPCIe reset 
	miniPCIe_RST_: miniPCIe_RST_ {
		compatible = "regulator-fixed";
		regulator-name = "miniPCIe_RST_";
		regulator-boot-on;
		regulator-always-on;
		enable-active-high;
		gpios = <&gpio4 RK_PC1 GPIO_ACTIVE_HIGH>;
		vin-supply = <&vcc4v0_sys>;
		status = "okay";
	};
	
	//X38
	//m.2 and miniPCIe reset 
	M2kB_PCIE_RSTn: M2kB_PCIE_RSTn {
		compatible = "regulator-fixed";
		regulator-name = "M2kB_PCIE_RSTn";
		regulator-boot-on;
		regulator-always-on;
		enable-active-high;
		gpios = <&gpio1 RK_PA2 GPIO_ACTIVE_HIGH>;
		vin-supply = <&vcc4v0_sys>;
		status = "okay";
	};
	

    hdmi1_sound: hdmi1-sound {
		status = "okay";
		compatible = "rockchip,hdmi";
		rockchip,mclk-fs = <128>;
		rockchip,card-name = "rockchip-hdmi1";
		rockchip,cpu = <&i2s6_8ch>;
		rockchip,codec = <&hdmi1>;
		rockchip,jack-det;
	};
	
    // If hdmirx node is disabled, delete the reserved-memory node here. 
	reserved-memory {
		#address-cells = <2>;
		#size-cells = <2>;
		ranges;

		// Reserve 256MB memory for hdmirx-controller@fdee0000
		cma {
			compatible = "shared-dma-pool";
			reusable;
			reg = <0x0 (256 * 0x100000) 0x0 (256 * 0x100000)>;
			linux,cma-default;
		};
		drm_logo: drm-logo@00000000 {
			compatible = "rockchip,drm-logo";
			reg = <0x0 0x0 0x0 0x0>;
		};

		drm_cubic_lut: drm-cubic-lut@00000000 {
			compatible = "rockchip,drm-cubic-lut";
			reg = <0x0 0x0 0x0 0x0>;
		};

		ramoops: ramoops@110000 {
			compatible = "ramoops";
			reg = <0x0 0x110000 0x0 0xf0000>;
			record-size = <0x20000>;
			console-size = <0x80000>;
			ftrace-size = <0x00000>;
			pmsg-size = <0x50000>;
		};
	};
	
    hdmiin_dc: hdmiin-dc {
		compatible = "rockchip,dummy-codec";
		#sound-dai-cells = <0>;
	};
	
	edp0_sound: edp0-sound {
		status = "okay";
		compatible = "simple-audio-card";
		simple-audio-card,name = "rockchip-edp-sound";

		simple-audio-card,cpu {
			sound-dai = <&spdif_tx3>;
		};
		simple-audio-card,codec {
			sound-dai = <&edp0 1>;
		};
	};
	
    dp-con {
		compatible = "dp-connector";
		status = "okay";
    
		port {
			dp_con_in_edp0: endpoint {
				remote-endpoint = <&edp0_out_dp_con>;
			};
		};
	};
	
    test-power {
		status = "okay";
	};
	
	fan0: pwm-fan {
		compatible = "pwm-fan";
		#cooling-cells = <2>;
		cooling-levels = <72 94 117 139 162 184 207 229 255>;
		pwms = <&pwm12 0 10000 0>;
	};
};
	
//=============================================================================
//  //SPI2  PMIC
//=============================================================================
&spi2 {
	status = "okay";
	assigned-clocks = <&cru CLK_SPI2>;
	assigned-clock-rates = <200000000>;
	pinctrl-names = "default";
	pinctrl-0 = <&spi2m2_cs0 &spi2m2_pins>;
	num-cs = <1>;
	
    //D1 //PMIC
	rk806: rk806@0 {
		compatible = "rockchip,rk806";
		spi-max-frequency = <1000000>;
		reg = <0x0>;

		interrupt-parent = <&gpio0>;
		interrupts = <7 IRQ_TYPE_LEVEL_LOW>;

		pinctrl-names = "default", "pmic-power-off";
		pinctrl-0 = <&pmic_pins_matx>, <&rk806_dvs1_null>, <&rk806_dvs2_null>, <&rk806_dvs3_null>;
		pinctrl-1 = <&rk806_dvs1_pwrdn>;

		//2800mv-3500mv 
		low_voltage_threshold = <3000>;
		// 2700mv-3400mv 
		shutdown_voltage_threshold = <2700>;
		// 140 160 
		shutdown_temperture_threshold = <160>;
		hotdie_temperture_threshold = <115>;

		// 0: restart PMU;
		// 1: reset all the power off reset registers,
		//    forcing the state to switch to ACTIVE mode;
		// 2: Reset all the power off reset registers,
		//    forcing the state to switch to ACTIVE mode,
		//    and simultaneously pull down the RESETB PIN for 5mS before releasing

		pmic-reset-func = <1>;

		vcc1-supply = <&vcc4v0_sys>;
		vcc2-supply = <&vcc4v0_sys>;
		vcc3-supply = <&vcc4v0_sys>;
		vcc4-supply = <&vcc4v0_sys>;
		vcc5-supply = <&vcc4v0_sys>;
		vcc6-supply = <&vcc4v0_sys>;
		vcc7-supply = <&vcc4v0_sys>;
		vcc8-supply = <&vcc4v0_sys>;
		vcc9-supply = <&vcc4v0_sys>;
		vcc10-supply = <&vcc4v0_sys>;
		vcc11-supply = <&vcc_2v0_pldo_s3>;
		vcc12-supply = <&vcc4v0_sys>;
		vcc13-supply = <&vcc_1v1_nldo_s3>;
		vcc14-supply = <&vcc_1v1_nldo_s3>;
		vcca-supply = <&vcc4v0_sys>;

		pwrkey {
			status = "okay";
		};

		pinctrl_rk806: pinctrl_rk806 {
			gpio-controller;
			#gpio-cells = <2>;

			rk806_dvs1_null: rk806_dvs1_null {
				pins = "gpio_pwrctrl2";
				function = "pin_fun0";
			};

			rk806_dvs1_slp: rk806_dvs1_slp {
				pins = "gpio_pwrctrl1";
				function = "pin_fun1";
			};

			rk806_dvs1_pwrdn: rk806_dvs1_pwrdn {
				pins = "gpio_pwrctrl1";
				function = "pin_fun2";
			};

			rk806_dvs1_rst: rk806_dvs1_rst {
				pins = "gpio_pwrctrl1";
				function = "pin_fun3";
			};

			rk806_dvs2_null: rk806_dvs2_null {
				pins = "gpio_pwrctrl2";
				function = "pin_fun0";
			};

			rk806_dvs2_slp: rk806_dvs2_slp {
				pins = "gpio_pwrctrl2";
				function = "pin_fun1";
			};

			rk806_dvs2_pwrdn: rk806_dvs2_pwrdn {
				pins = "gpio_pwrctrl2";
				function = "pin_fun2";
			};

			rk806_dvs2_rst: rk806_dvs2_rst {
				pins = "gpio_pwrctrl2";
				function = "pin_fun3";
			};

			rk806_dvs2_dvs: rk806_dvs2_dvs {
				pins = "gpio_pwrctrl2";
				function = "pin_fun4";
			};

			rk806_dvs2_gpio: rk806_dvs2_gpio {
				pins = "gpio_pwrctrl2";
				function = "pin_fun5";
			};

			rk806_dvs3_null: rk806_dvs3_null {
				pins = "gpio_pwrctrl3";
				function = "pin_fun0";
			};

			rk806_dvs3_slp: rk806_dvs3_slp {
				pins = "gpio_pwrctrl3";
				function = "pin_fun1";
			};

			rk806_dvs3_pwrdn: rk806_dvs3_pwrdn {
				pins = "gpio_pwrctrl3";
				function = "pin_fun2";
			};

			rk806_dvs3_rst: rk806_dvs3_rst {
				pins = "gpio_pwrctrl3";
				function = "pin_fun3";
			};

			rk806_dvs3_dvs: rk806_dvs3_dvs {
				pins = "gpio_pwrctrl3";
				function = "pin_fun4";
			};

			rk806_dvs3_gpio: rk806_dvs3_gpio {
				pins = "gpio_pwrctrl3";
				function = "pin_fun5";
			};
		};

		regulators {
			vdd_gpu_s0: vdd_gpu_mem_s0: DCDC_REG1 {
				regulator-boot-on;
				regulator-min-microvolt = <550000>;
				regulator-max-microvolt = <950000>;
				regulator-ramp-delay = <12500>;
				regulator-name = "vdd_gpu_s0";
				regulator-enable-ramp-delay = <400>;
				regulator-state-mem {
					regulator-off-in-suspend;
				};
			};

			vdd_cpu_lit_s0: vdd_cpu_lit_mem_s0: DCDC_REG2 {
				regulator-always-on;
				regulator-boot-on;
				regulator-min-microvolt = <550000>;
				regulator-max-microvolt = <950000>;
				regulator-ramp-delay = <12500>;
				regulator-name = "vdd_cpu_lit_s0";
				regulator-state-mem {
					regulator-off-in-suspend;
				};
			};

			vdd_log_s0: DCDC_REG3 {
				regulator-always-on;
				regulator-boot-on;
				regulator-min-microvolt = <675000>;
				regulator-max-microvolt = <750000>;
				regulator-ramp-delay = <12500>;
				regulator-name = "vdd_log_s0";
				regulator-state-mem {
					regulator-off-in-suspend;
					regulator-suspend-microvolt = <750000>;
				};
			};

			vdd_vdenc_s0: vdd_vdenc_mem_s0: DCDC_REG4 {
				regulator-always-on;
				regulator-boot-on;
				regulator-min-microvolt = <550000>;
				regulator-max-microvolt = <950000>;
				regulator-init-microvolt = <750000>;
				regulator-ramp-delay = <12500>;
				regulator-name = "vdd_vdenc_s0";
				regulator-state-mem {
					regulator-off-in-suspend;
				};
			};

			vdd_ddr_s0: DCDC_REG5 {
				regulator-always-on;
				regulator-boot-on;
				regulator-min-microvolt = <675000>;
				regulator-max-microvolt = <900000>;
				regulator-ramp-delay = <12500>;
				regulator-name = "vdd_ddr_s0";
				regulator-state-mem {
					regulator-off-in-suspend;
					regulator-suspend-microvolt = <850000>;
				};
			};

			vdd2_ddr_s3: DCDC_REG6 {
				regulator-always-on;
				regulator-boot-on;
				regulator-name = "vdd2_ddr_s3";
				regulator-state-mem {
					regulator-on-in-suspend;
				};
			};

			vcc_2v0_pldo_s3: DCDC_REG7 {
				regulator-always-on;
				regulator-boot-on;
				regulator-min-microvolt = <2000000>;
				regulator-max-microvolt = <2000000>;
				regulator-name = "vdd_2v0_pldo_s3";
				regulator-state-mem {
					regulator-on-in-suspend;
					regulator-suspend-microvolt = <2000000>;
				};
			};

			vcc_3v3: DCDC_REG8 {
				regulator-always-on;
				regulator-boot-on;
				regulator-min-microvolt = <3300000>;
				regulator-max-microvolt = <3300000>;
				regulator-name = "vcc_3v3_s3";
				regulator-state-mem {
					regulator-on-in-suspend;
					regulator-suspend-microvolt = <3300000>;
				};
			};

			vddq_ddr_s0: DCDC_REG9 {
				regulator-always-on;
				regulator-boot-on;
				regulator-name = "vddq_ddr_s0";
				regulator-state-mem {
					regulator-off-in-suspend;
				};
			};

			vcc_1v8_s3: DCDC_REG10 {
				regulator-always-on;
				regulator-boot-on;
				regulator-min-microvolt = <1800000>;
				regulator-max-microvolt = <1800000>;
				regulator-name = "vcc_1v8_s3";
				regulator-state-mem {
					regulator-on-in-suspend;
					regulator-suspend-microvolt = <1800000>;
				};
			};

			vcca_1v8_s0: PLDO_REG1 {
				regulator-always-on;
				regulator-boot-on;
				regulator-min-microvolt = <1800000>;
				regulator-max-microvolt = <1800000>;
				regulator-name = "avcc_1v8_s0";
				regulator-state-mem {
					regulator-off-in-suspend;
				};
			};

			vcc_1v8_s0: PLDO_REG2 {
				regulator-always-on;
				regulator-boot-on;
				regulator-min-microvolt = <1800000>;
				regulator-max-microvolt = <1800000>;
				regulator-name = "vcc_1v8_s0";
				regulator-state-mem {
					regulator-off-in-suspend;
					regulator-suspend-microvolt = <1800000>;
				};
			};

			vdda_1v2_s0: PLDO_REG3 {
				regulator-always-on;
				regulator-boot-on;
				regulator-min-microvolt = <1200000>;
				regulator-max-microvolt = <1200000>;
				regulator-name = "avdd_1v2_s0";
				regulator-state-mem {
					regulator-off-in-suspend;
				};
			};

			vcca_3v3_s0: PLDO_REG4 {
				regulator-always-on;
				regulator-boot-on;
				regulator-min-microvolt = <3300000>;
				regulator-max-microvolt = <3300000>;
				regulator-name = "vcc_3v3_s0";
				regulator-state-mem {
					regulator-off-in-suspend;
				};
			};

			vccio_sd_s0: PLDO_REG5 {
				regulator-always-on;
				regulator-boot-on;
				regulator-min-microvolt = <1800000>;
				regulator-max-microvolt = <3300000>;
				regulator-name = "vccio_sd_s0";
				regulator-state-mem {
					regulator-off-in-suspend;
				};
			};
            
			vcc_1v8_s3_PLDO6: PLDO_REG6 {
				regulator-always-on;
				regulator-boot-on;
				regulator-min-microvolt = <1800000>;
				regulator-max-microvolt = <1800000>;
				regulator-name = "pldo6_s3";
				regulator-state-mem {
					regulator-on-in-suspend;
					regulator-suspend-microvolt = <1800000>;
				};
			};

			vdd_0v75_s3: NLDO_REG1 {
				regulator-always-on;
				regulator-boot-on;
				regulator-min-microvolt = <750000>;
				regulator-max-microvolt = <750000>;
				regulator-name = "vdd_0v75_s3";
				regulator-state-mem {
					regulator-on-in-suspend;
					regulator-suspend-microvolt = <750000>;
				};
			};

			vdda_ddr_pll_s0: NLDO_REG2 {
				regulator-always-on;
				regulator-boot-on;
				regulator-min-microvolt = <850000>;
				regulator-max-microvolt = <850000>;
				regulator-name = "vdd_ddr_pll_s0";
				regulator-state-mem {
					regulator-off-in-suspend;
					regulator-suspend-microvolt = <850000>;
				};
			};

			vdda_0v75_s0: NLDO_REG3 {
				regulator-always-on;
				regulator-boot-on;
				regulator-min-microvolt = <837500>;
				regulator-max-microvolt = <837500>;
				regulator-name = "avdd_0v75_s0";
				regulator-state-mem {
					regulator-off-in-suspend;
				};
			};

			vdda_0v85_s0: NLDO_REG4 {
				regulator-always-on;
				regulator-boot-on;
				regulator-min-microvolt = <850000>;
				regulator-max-microvolt = <850000>;
				regulator-name = "vdd_0v85_s0";
				regulator-state-mem {
					regulator-off-in-suspend;
				};
			};

			vdd_0v75_s0: NLDO_REG5 {
				regulator-always-on;
				regulator-boot-on;
				regulator-min-microvolt = <750000>;
				regulator-max-microvolt = <750000>;
				regulator-name = "vdd_0v75_s0";
				regulator-state-mem {
					regulator-off-in-suspend;
				};
			};
		};
	};

};

//=============================================================================
//  //I2C 
//=============================================================================
&i2c0 {
	status = "okay";
	pinctrl-names = "default";
	pinctrl-0 = <&i2c0m2_xfer>;
    
    //D2
	vdd_cpu_big0_s0: vdd_cpu_big0_mem_s0: rk8602@42 {
		compatible = "rockchip,rk8602";
		reg = <0x42>;
		vin-supply = <&vcc4v0_sys>;
		regulator-compatible = "rk860x-reg";
		regulator-name = "vdd_cpu_big0_s0";
		regulator-min-microvolt = <550000>;
		regulator-max-microvolt = <1050000>;
		regulator-ramp-delay = <2300>;
		rockchip,suspend-voltage-selector = <1>;
		regulator-boot-on;
		regulator-always-on;
		regulator-state-mem {
			regulator-off-in-suspend;
		};
	};

	//D4
	vdd_cpu_big1_s0: vdd_cpu_big1_mem_s0: rk8603@43 {
		compatible = "rockchip,rk8603";
		reg = <0x43>;
		vin-supply = <&vcc4v0_sys>;
		regulator-compatible = "rk860x-reg";
		regulator-name = "vdd_cpu_big1_s0";
		regulator-min-microvolt = <550000>;
		regulator-max-microvolt = <1050000>;
		regulator-ramp-delay = <2300>;
		rockchip,suspend-voltage-selector = <1>;
		regulator-boot-on;
		regulator-always-on;
		regulator-state-mem {
			regulator-off-in-suspend;
		};
	};
};

&i2c1 {
	status = "okay";
	pinctrl-names = "default";
	pinctrl-0 = <&i2c1m2_xfer>;
    
    //D3
	vdd_npu_s0: vdd_npu_mem_s0: rk8602@42 {
		compatible = "rockchip,rk8602";
		reg = <0x42>;
		vin-supply = <&vcc4v0_sys>;
		regulator-compatible = "rk860x-reg";
		regulator-name = "vdd_npu_s0";
		regulator-min-microvolt = <550000>;
		regulator-max-microvolt = <950000>;
		regulator-ramp-delay = <2300>;
		rockchip,suspend-voltage-selector = <1>;
		regulator-boot-on;
		regulator-always-on;
		regulator-state-mem {
			regulator-off-in-suspend;
		};
	};
	
	//X22 PCIeX4
};

&i2c4 {
	clock-frequency = <400000>;
	pinctrl-names = "default";
	pinctrl-0 = <&i2c4m2_xfer>;
	status = "okay";

	//X20 (M.2 key B) SMBUS

	//D37  //Serial AT24C02C-SSHM-T
	//CHECK_IT //FIx addr
    eeprom@50 {
        compatible = "atmel,24c02";
        reg = <0x52>;
    };
    
    //D38   //Temp Sensor TMP102
    tmp102: tmp102@48{
		compatible = "ti,tmp102";
		reg = <0x48>;
        interrupt-parent = <&gpio3>;
		interrupts = <RK_PD3 IRQ_TYPE_LEVEL_LOW>;
		#thermal-sensor-cells = <0>;
	};
	
    // D43
	hym8563: rtc@51 {
		compatible = "haoyu,hym8563";
		reg = <0x51>;
		#clock-cells = <0>;
		clock-output-names = "rtc_32khz";
		rtc_clock: rtc_clock {
			compatible = "fixed-clock";
			#clock-cells = <0>;
			clock-frequency = <32768>;
		};
	};
	
	//Optional
	//X20 //m.2 Key B
	//X38 //miniPCIe
};

&i2c7 {
	pinctrl-0 = <&i2c7m0_xfer>;
	status = "okay";

	//D41
	es8388: audio-codec@11 {
		compatible = "everest,es8388";
		reg = <0x11>;
		assigned-clock-rates = <12288000>;
		assigned-clocks = <&cru I2S0_8CH_MCLKOUT>;
		AVDD-supply = <&vcca_3v3_s0>;
		clock-names = "mclk";
		clocks = <&cru I2S0_8CH_MCLKOUT>;
		DVDD-supply = <&vcc_1v8_s0>;
		HPVDD-supply = <&vcca_3v3_s0>;
		PVDD-supply = <&vcc_1v8_s0>;
		#sound-dai-cells = <0>;

		port {
			es8388_p0_0: endpoint {
				remote-endpoint = <&i2s0_8ch_p0_0>;
			};
		};
	};
};

//=============================================================================
//  I2S
//=============================================================================
//I2S0
//Typical digital audio I/O
&i2s0_8ch {
	pinctrl-names = "default";
	pinctrl-0 = <&i2s0_lrck
		     &i2s0_mclk
		     &i2s0_sclk
		     &i2s0_sdi0
		     &i2s0_sdo0>;
	status = "okay";

	i2s0_8ch_p0: port {
		i2s0_8ch_p0_0: endpoint {
			dai-format = "i2s";
			mclk-fs = <256>;
			remote-endpoint = <&es8388_p0_0>;
		};
	};
};

//HDMI1 SOUND
&i2s6_8ch {
	status = "okay";
};

//HDMIIN SOUND
&i2s7_8ch {
	status = "okay";
};

//=============================================================================
//  //CPU
//=============================================================================
//D8    //CPU
&cpu_l0 {
	cpu-supply = <&vdd_cpu_lit_s0>;
	mem-supply = <&vdd_cpu_lit_mem_s0>;
};

&cpu_b0 {
	cpu-supply = <&vdd_cpu_big0_s0>;
	mem-supply = <&vdd_cpu_big0_mem_s0>;
};

&cpu_b2 {
	cpu-supply = <&vdd_cpu_big1_s0>;
	mem-supply = <&vdd_cpu_big1_mem_s0>;
};

//=============================================================================
//  //LPDDR4
//=============================================================================
//D9 D10    //LPDDR4
&dmc {
	status = "okay";
	center-supply = <&vdd_ddr_s0>;
	mem-supply = <&vdd_log_s0>;
};
&dfi {
	status = "okay";
};

//=============================================================================
//  //SPI FLASH //Muxed with eMMC   //Control by D13 (TS3A27518ERTWR)
//=============================================================================
//CHECK_IT TS3A275?
/*
&sfc {
	status = "okay";
	max-freq = <50000000>;
	#address-cells = <1>;
	#size-cells = <0>;
	pinctrl-names = "default";
	pinctrl-0 = <&fspim0_pins>;

	//D12
	spi_flash: spi-flash@0 {
		#address-cells = <1>;
		#size-cells = <0>;
		compatible = "jedec,spi-nor";
		reg = <0x0>;
		spi-max-frequency = <50000000>;
		spi-tx-bus-width = <1>;
		spi-rx-bus-width = <4>;
		status = "okay";

		partitions {
			compatible = "fixed-partitions";
			#address-cells = <1>;
			#size-cells = <1>;

			loader@0 {
				label = "loader";
				reg = <0x0 0x1000000>;
			};
		};
	};
};
*/

//=============================================================================
//  SDIO SD eMMC
//=============================================================================
//D11   //eMMC
&sdhci {
	bus-width = <8>;
	no-sdio;
	no-sd;
	non-removable;
	max-frequency = <200000000>;
	mmc-hs400-1_8v;
	mmc-hs400-enhanced-strobe;
	status = "okay";
};

//SD Card
&sdmmc {
	max-frequency = <200000000>;
	no-sdio;
	no-mmc;
	bus-width = <4>;
	cap-mmc-highspeed;
	cap-sd-highspeed;
	disable-wp;
	sd-uhs-sdr104;
	vmmc-supply = <&vcc_3v3>;
	vqmmc-supply = <&vccio_sd_s0>;
	pinctrl-names = "default";
	pinctrl-0 = <&sdmmc_bus4 &sdmmc_clk &sdmmc_cmd &sdmmc_det>;
	status = "okay";
};
/*
//A1 //Muxing with SD Card
&sdmmc {
    // WiFi & BT combo module Fn-Link 8223A-SR 
	bus-width = <4>;
	cap-sd-highspeed;
	disable-wp;
	non-removable;
	mmc-pwrseq = <&sdio_pwrseq>;
	pinctrl-names = "default";
	pinctrl-0 = <&sdmmc_bus4 &sdmmc_clk &sdmmc_cmd &sdmmc_det>;
	sd-uhs-sdr104;
	vmmc-supply = <&vcc_3v3>;
	vqmmc-supply = <&vcc_1v8>;
	rockchip,default-sample-phase = <90>;
	status = "okay";
};
*/

//SDIO NOT USE
/*
&sdio {
	max-frequency = <150000000>;
	supports-sdio;
	bus-width = <4>;
	disable-wp;
	cap-sd-highspeed;
	cap-sdio-irq;
	keep-power-in-suspend;
	mmc-pwrseq = <&sdio_pwrseq>;
	non-removable;
	num-slots = <1>;
	pinctrl-names = "default";
	pinctrl-0 = <&sdiom0_pins>;
	sd-uhs-sdr104;
	status = "okay";
};
*/
//=============================================================================
//  //ETHERNET (GMAC)
//=============================================================================
//D14   //GMAC0 PHY //RTL8211FI
&gmac0 {
	status = "okay";
	// Use rgmii-id mode, use both delays
	phy-mode = "rgmii-id";
	clock_in_out = "input";

	// PHY hardware reset, active low
	snps,reset-gpio = <&gpio3 RK_PB2 GPIO_ACTIVE_LOW>;
	snps,reset-active-low;

	// Reset time is 20ms, 100ms for rtl8211f
	snps,reset-delays-us = <0 20000 100000>;

	pinctrl-names = "default";
	pinctrl-0 = <&gmac0_miim
			&gmac0_tx_bus2
			&gmac0_rx_bus2
			&gmac0_rgmii_clk
			&gmac0_rgmii_bus
			&gmac0_clkinout
			&rgmii_phy0_reset_pin>;

	tx_delay = <0x25>;
	rx_delay = <0x25>; 

	phy-handle = <&rgmii_phy0>;
};

&mdio0 {
	rgmii_phy0: phy@1 {
		compatible = "ethernet-phy-ieee802.3-c22";
		reg = <0x1>;
	};
};

//D15   //GMAC1 PHY //RTL8211FI
&gmac1 {
	status = "okay";
	// Use rgmii-id mode, use both delays
	phy-mode = "rgmii-id";
	clock_in_out = "input";

	// PHY hardware reset, active low
	snps,reset-gpio = <&gpio3 RK_PB7 GPIO_ACTIVE_LOW>;
	snps,reset-active-low;

	// Reset time is 20ms, 100ms for rtl8211f
	snps,reset-delays-us = <0 20000 100000>;

	pinctrl-names = "default";
	pinctrl-0 = <&gmac1_miim
			&gmac1_tx_bus2
			&gmac1_rx_bus2
			&gmac1_rgmii_clk
			&gmac1_rgmii_bus
			&gmac1_clkinout
			&rgmii_phy1_reset_pin>;

	tx_delay = <0x25>;
	rx_delay = <0x25>; 

	phy-handle = <&rgmii_phy1>;
};

&mdio1 {
	rgmii_phy1: phy@1 {
		compatible = "ethernet-phy-ieee802.3-c22";
		reg = <0x1>;
	};
};

//=============================================================================
//  PINCTL
//=============================================================================
&pinctrl {
	pmic {
		pmic_pins_matx: pmic-pins-matx {
			rockchip,pins =
				/* pmic_int_l */
				<0 RK_PA7 0 &pcfg_pull_up>,
				/* pmic_sleep1 */
				<0 RK_PA2 1 &pcfg_pull_none>,
				/* pmic_sleep2 */
				<0 RK_PC3 1 &pcfg_pull_none>,
				/* pmic_sleep3 */
				<0 RK_PC2 1 &pcfg_pull_none>;
		};
	};
	
    ethernet {
		rgmii_phy0_reset_pin: rgmii-phy0-reset-pin {
			rockchip,pins = <3 RK_PB2 RK_FUNC_GPIO &pcfg_pull_none>;
		};
		rgmii_phy1_reset_pin: rgmii-phy1-reset-pin {
			rockchip,pins = <3 RK_PB7 RK_FUNC_GPIO &pcfg_pull_none>;
		};
	};
	
	watchdog{
        watchdog_gpio_wdi{
            rockchip,pins = <4 RK_PA7 RK_FUNC_GPIO &pcfg_pull_none>;
        };
        watchdog_disable{
            rockchip,pins = <4 RK_PA6 RK_FUNC_GPIO &pcfg_pull_none>;
        };
	};
	
    sdio-pwrseq {
		wlan_en_pin: wlan-en-pin {
			rockchip,pins = <4 RK_PA5 RK_FUNC_GPIO &pcfg_pull_none>;
		};
	};
	
    pcie {
        //miniPCIe_RST_
        minipcie_rst_pin: minipcie_rst_pin {
            rockchip,pins = <4 RK_PC1 RK_FUNC_GPIO &pcfg_pull_none>;
        };
        //PCIe_RST_
        pcie_rst_pin: pcie_rst_pin {
            rockchip,pins = <1 RK_PB2 RK_FUNC_GPIO &pcfg_pull_none>;
        };
        
    };

};

&rng {
	status = "okay";
};

//=============================================================================
//  //SPI 
//=============================================================================
//No One

//=============================================================================
//  //PCIE SATA
//============================================================================
//-----------------------------------------------------------------------------
//          PCIe20_0 muxing with SATA30_0
//pcie2x1l2 is PCIe20_0
//pcie2x1l2 can use COMBO_PHY_0_LANE0 only

//SATA_0_
&combphy0_ps {
	status = "okay";
};
&pcie2x1l2 {
	status = "disabled";
};
&sata0 {
	status = "okay";
};
//-----------------------------------------------------------------------------
//          PCIe20_1 muxing with SATA30_1
//is PCIe20_1
//pcie2x1l0 can use PCIE30_PORT0_LANE1 or COMBO_PHY_1_LANE0. Controlled by pcie30-phymode.

//	This controller is phy for sata1 or pcie2x1l0 controllers
&combphy1_ps {
	status = "okay";
};
//SATA_1    
//X20   M.2 Key B SATA
&sata1 {
    //	If this controller is enabled, pcie2x1l0 must be disabled
	//status = "disabled";
	status = "okay";
};

//PCIE
//X38 miniPCIe on COMBO_PHY_1_LANE0
//	If this controller is enabled, sata1 must be disabled
&pcie2x1l0 {
//M2kB_PCIE_RSTn
	vpcie3v3-supply = <&vcc_3v3>;			
	status = "disabled";
	//status = "okay";
};

//-----------------------------------------------------------------------------
//          PCIe20_2 muxing with SATA30_2 and USB30_2 (usbhost3_0)
//pcie2x1l1 is PCIe20_2
//pcie2x1l1 can use PCIE30_PORT1_LANE1 or COMBO_PHY_2_LANE0. Controlled by pcie30-phymode.

//PCIe20_2 is disabled now
&combphy2_psu {
	status = "okay";
};
&usbhost3_0 {
	status = "disabled";
};
&usbhost_dwc3_0 {
	status = "disabled";
};
&sata2 {
	status = "disabled";
};

//PCIe20_2
//OUT Lane D on PCIE30_PORT1_LANE1  
//x21 MiniPCIe
&pcie2x1l1 {
    //CHECK_IT  //Set this
    //miniPCIe_RST_
    //reset-gpios = <&gpio4 RK_PC1 GPIO_ACTIVE_HIGH>;
    //pinctrl-names = "default";
	//pinctrl-0 = <&minipcie_rst_pin>;
	vpcie3v3-supply = <&vcc_3v3>;	
	status = "okay";
};

//=============================================================================
//  //PCIe3X4   //PCIE30_PORT0  //Subsystem Protocol Link Mapping
//  //PCIe_RST_
//=============================================================================
&pcie30phy {
//PHY_MODE_PCIE_AGGREGATION 4	/* PCIe3x4 */
//PHY_MODE_PCIE_NANBNB	0	/* P1:PCIe3x2  +  P0:PCIe3x2 */
//PHY_MODE_PCIE_NANBBI	1	/* P1:PCIe3x2  +  P0:PCIe3x1*2 */
//PHY_MODE_PCIE_NABINB	2	/* P1:PCIe3x1*2 + P0:PCIe3x2 */
//PHY_MODE_PCIE_NABIBI	3	/* P1:PCIe3x1*2 + P0:PCIe3x1*2 */
    rockchip,pcie30-phymode = <PHY_MODE_PCIE_AGGREGATION>;   
	status = "okay";
};

//X22 pcie slot
&pcie3x4 {
    //CHECK_IT  //Set this
    //PCIe_RST_
    //reset-gpios = <&gpio1 RK_PB2 GPIO_ACTIVE_HIGH>;
    //pinctrl-names = "default";
	//pinctrl-0 = <&pcie_rst_pin>;
	vpcie3v3-supply = <&vcc_3v3>;
	status = "okay";
};
//=============================================================================
//  //PCIe3X2   //PCIE30_PORT1  //Subsystem Protocol Link Mapping
//  //PCIe_RST_
//=============================================================================
&pcie3x2 {
    vpcie3v3-supply = <&vcc_3v3>;
	status = "disabled";
};

//=============================================================================
//  //USB 2.0
//=============================================================================

////USB20_HOST0
&usb_host0_ehci {
	status = "okay";
};

&usb_host0_ohci {
	status = "okay";
};

&u2phy2 {
	status = "okay";
};

&u2phy2_host {
	status = "okay";
};

//USB20_HOST1
&usb_host1_ehci {
	status = "okay";
};

&usb_host1_ohci {
	status = "okay";
};

&u2phy3 {
	status = "okay";
};

&u2phy3_host {
	status = "okay";
};


//=============================================================================
//  //USB 3.0
//=============================================================================
&u2phy1 {
	status = "okay";
};

&u2phy1_otg {
	status = "okay";
};

&usbdrd3_1{
	status = "okay";
};

&usbdrd_dwc3_1{
	status = "okay";
};

&usbdp_phy1 {
	status = "okay";
};

&usbdp_phy1_u3 {
	status = "okay";
};

//=============================================================================
//  USB 3.0
//=============================================================================

&u2phy0 {
	status = "okay";
};

&u2phy0_otg {
	rockchip,typec-vbus-det;
	status = "okay";
};

&usbdrd3_0 {
	status = "okay";
};

&usbdp_phy0 {
	status = "okay";
};

&usbdrd_dwc3_0 {
	//dr_mode = "otg";
	dr_mode = "host";
	status = "okay";
};

&usbdp_phy0_u3 {
	status = "okay";
};

//=============================================================================
//  NPU
//=============================================================================
&rknpu {
	rknpu-supply = <&vdd_npu_s0>;
	mem-supply = <&vdd_npu_mem_s0>;
	status = "okay";
};

&rknpu_mmu {
	status = "okay";
};

//=============================================================================
//  //CHECK_IT //NEED?
//=============================================================================
//CHECK_IT //TEST
//&vcca_1v8_s0 {
//	regulator-state-mem {
//		regulator-on-in-suspend;
//		regulator-suspend-microvolt = <1800000>;
//	};
//};
&saradc {
	status = "okay";
	vref-supply = <&vcca_1v8_s0>;
};


//=============================================================================
//  THERMAL
//=============================================================================

//thermal_zones
&tsadc {
	status = "okay";
};

&soc_thermal {
	polling-delay = <1000>;
	polling-delay-passive = <2000>;
	trips {
		trip0: trip-point@0 {
			temperature = <45000>;
			hysteresis = <5000>;
			type = "active";
		};
		trip1: trip-point@1 {
			temperature = <50000>;
			hysteresis = <5000>;
			type = "active";
		};
		trip2: trip-point@2 {
			temperature = <55000>;
			hysteresis = <5000>;
			type = "active";
		};
		trip3: trip-point@3 {
			temperature = <60000>;
			hysteresis = <5000>;
			type = "active";
		};
		trip4: trip-point@4 {
			temperature = <65000>;
			hysteresis = <5000>;
			type = "active";
		};
		trip5: trip-point@5 {
			temperature = <70000>;
			hysteresis = <5000>;
			type = "active";
		};
		trip6: trip-point@6 {
			temperature = <75000>;
			hysteresis = <5000>;
			type = "active";
		};
		pcritical: trip-point@7 {
			temperature = <80000>;
			hysteresis = <1000>;
			type = "active";
		};
	};
	
	cooling-maps {
		map0 {
			trip = <&trip0>;
			cooling-device = <&fan0 0 1>;
			contribution = <1024>;
		};
		map1 {
			trip = <&trip1>;
			cooling-device = <&fan0 1 2>;
			contribution = <1024>;
		};
		map2 {
			trip = <&trip2>;
			cooling-device = <&fan0 2 3>;
			contribution = <1024>;
		};
		map3 {
			trip = <&trip3>;
			cooling-device = <&fan0 3 4>;
			contribution = <1024>;
		};
		map4 {
			trip = <&trip4>;
			cooling-device = <&fan0 4 5>;
			contribution = <1024>;
		};
		map5 {
			trip = <&trip5>;
			cooling-device = <&fan0 5 6>;
			contribution = <1024>;
		};
		map6 {
			trip = <&trip6>;
			cooling-device = <&fan0 6 7>;
			contribution = <1024>;
		};
		map7 {
			trip = <&pcritical>;
			cooling-device = <&fan0 7 8>;
			contribution = <1024>;
		};
	};
};


//=============================================================================
//  UART
//=============================================================================

&uart1 {
	status = "okay";
	pinctrl-names = "default";
	pinctrl-0 = <&uart1m1_xfer &uart1m1_ctsn &uart1m1_rtsn>;
	

    
};

//=============================================================================
//  UART
//=============================================================================
&uart1 {
	pinctrl-names = "default";
	pinctrl-0 = <&uart1m1_xfer &uart1m1_ctsn &uart1m1_rtsn>;
	uart-has-rtscts;
	status = "okay";
    
    //A1    //8223A-SR
	bluetooth {
		compatible = "qcom,qca9377-bt";
		clocks = <&rtc_clock>;
		clock-names = "lpo";
		//enable-gpios = <&gpio4 RK_PA0 GPIO_ACTIVE_HIGH>; // BT_RST
		max-speed = <2000000>;
		//pinctrl-names = "default";
		//pinctrl-0 = <&bt_en_pin>;
	};
};

//FIQ Debugger
//D33 //USB_UART //DBG_UART //RS232_1 (Не напаян)
/*
&uart2 {
	status = "okay";
	pinctrl-names = "default";
	pinctrl-0 = <&uart2m0_xfer>;
};
*/

//X29 1.8V UART
&uart3 {
	status = "okay";
	pinctrl-names = "default";
	pinctrl-0 = <&uart3m0_xfer>;
};

//X27 RS232_2
&uart4 {
	status = "okay";
	pinctrl-names = "default";
	pinctrl-0 = <&uart4m1_xfer>;
};

//X28 3.3V
&uart9 {
	status = "okay";
	pinctrl-names = "default";
	pinctrl-0 = <&uart9m2_xfer>;
};


//=============================================================================
//  VIDEO   HDMI    DP
//=============================================================================

&gpu {
	mali-supply = <&vdd_gpu_s0>;
	mem-supply = <&vdd_gpu_mem_s0>;
	status = "okay";
};

&vop {
	status = "okay";
	disable-win-move;
	assigned-clocks = <&cru ACLK_VOP>;
	assigned-clock-rates = <800000000>;
};

&vop_mmu {
	status = "okay";
};

&vepu {
	status = "okay";
};

// vp0 & vp1 splice for 8K output
&vp0 {
	rockchip,plane-mask = <(1 << ROCKCHIP_VOP2_CLUSTER0 | 1 << ROCKCHIP_VOP2_ESMART0)>;
	rockchip,primary-plane = <ROCKCHIP_VOP2_ESMART0>;
};

&vp1 {
	rockchip,plane-mask = <(1 << ROCKCHIP_VOP2_CLUSTER1 | 1 << ROCKCHIP_VOP2_ESMART1)>;
	rockchip,primary-plane = <ROCKCHIP_VOP2_ESMART1>;
};

&vp2 {
	rockchip,plane-mask = <(1 << ROCKCHIP_VOP2_CLUSTER2 | 1 << ROCKCHIP_VOP2_ESMART2)>;
	rockchip,primary-plane = <ROCKCHIP_VOP2_ESMART2>;
};

&vp3 {
	rockchip,plane-mask = <(1 << ROCKCHIP_VOP2_CLUSTER3 | 1 << ROCKCHIP_VOP2_ESMART3)>;
	rockchip,primary-plane = <ROCKCHIP_VOP2_ESMART3>;
};

&display_subsystem {
	memory-region = <&drm_logo>;
	memory-region-names = "drm-logo";
	
	clocks = <&hdptxphy_hdmi_clk0>,<&hdptxphy_hdmi_clk1>;
	clock-names = "hdmi0_phy_pll", "hdmi1_phy_pll";
	
	ports = <&vop_out>;

	route {
		route_edp0: route-edp0 {
			status = "okay";
			logo,uboot = "logo.bmp";
			logo,kernel = "logo_kernel.bmp";
			logo,mode = "center";
			charge_logo,mode = "center";
			connect = <&vp0_out_edp0>;
		};

		route_hdmi1: route-hdmi1 {
			status = "okay";
			logo,uboot = "logo.bmp";
			logo,kernel = "logo_kernel.bmp";
			logo,mode = "center";
			charge_logo,mode = "center";
			connect = <&vp2_out_hdmi1>;
			force-output;
		};
	};
};
//----------    HDMO1   ----------

&hdptxphy_hdmi_clk1 {
	status = "okay";
};

&hdmi1 {
	status = "okay";
	pinctrl-names = "default";
	pinctrl-0 = <&hdmim0_tx1_hpd &hdmim1_tx1_scl &hdmim1_tx1_sda>;
    cec-enable = "false";
};

&hdmi1_in_vp0 {
	status = "disabled";
};

&hdmi1_in_vp1 {
	status = "disabled";
};

&hdmi1_in_vp2 {
	status = "okay";
};

&route_hdmi1 {
	status = "okay";
	force-output;
	connect = <&vp2_out_hdmi1>;
};

&hdmi1_sound {
	status = "okay";
};

&hdptxphy_hdmi1 {
	status = "okay";
};
//----------    EDP0   ----------
&hdptxphy_hdmi_clk0 {
	status = "okay";
};

&edp0 {
	status = "okay";
	pinctrl-names = "default";
	pinctrl-0 = <&hdmim0_tx0_hpd>;
	#sound-dai-cells = <1>;
    //force-hpd;
    
	ports {
		port@1 {
			reg = <1>;

			edp0_out_dp_con: endpoint {
				remote-endpoint = <&dp_con_in_edp0>;
			};
		};
	};

//	support-psr;
};

&hdptxphy0 {
	status = "okay";
};

&edp0_sound {
	status = "okay";
};

&spdif_tx3{
	status = "okay";
};

&edp0_in_vp0 {
	status = "okay";
};

&edp0_in_vp1 {
	status = "disabled";
};

&edp0_in_vp2 {
	status = "disabled";
};

&route_edp0 {
	status = "okay";
	force-output;
	connect = <&vp0_out_edp0>;
};


//=============================================================================
//  CODECS
//=============================================================================

&av1d {
	status = "okay";
};

&av1d_mmu {
	status = "okay";
};

&iep {
	status = "okay";
};

&iep_mmu {
	status = "okay";
};

&jpegd {
	status = "okay";
};

&jpegd_mmu {
	status = "okay";
};

&jpege_ccu {
	status = "okay";
};

&jpege0 {
	status = "okay";
};

&jpege0_mmu {
	status = "okay";
};

&jpege1 {
	status = "okay";
};

&jpege1_mmu {
	status = "okay";
};

&jpege2 {
	status = "okay";
};

&jpege2_mmu {
	status = "okay";
};

&jpege3 {
	status = "okay";
};

&jpege3_mmu {
	status = "okay";
};

&vdpu {
	status = "okay";
};

&vdpu_mmu {
	status = "okay";
};

&mpp_srv {
	status = "okay";
};

&rga3_core0 {
	status = "okay";
};

&rga3_0_mmu {
	status = "okay";
};

&rga3_core1 {
	status = "okay";
};

&rga3_1_mmu {
	status = "okay";
};

&rga2 {
	status = "okay";
};

&rkvdec_ccu {
	status = "okay";
};

&rkvdec0 {
	status = "okay";
};

&rkvdec0_mmu {
	status = "okay";
};

&rkvdec1 {
	status = "okay";
};

&rkvdec1_mmu {
	status = "okay";
};

&rkvenc_ccu {
	status = "okay";
};

&rkvenc0 {
	venc-supply = <&vdd_vdenc_s0>;
	mem-supply = <&vdd_vdenc_mem_s0>;
	status = "okay";
};

&rkvenc0_mmu {
	status = "okay";
};

&rkvenc1 {
	venc-supply = <&vdd_vdenc_s0>;
	mem-supply = <&vdd_vdenc_mem_s0>;
	status = "okay";
};

&rkvenc1_mmu {
	status = "okay";
};


//=============================================================================
//  PWM
//=============================================================================

//Fan Speed Control
//CPU_PWM
&pwm12 {
    status = "okay";
	pinctrl-0 = <&pwm12m1_pins>;
	
};


//=============================================================================
//      CAN
//=============================================================================
//x30
&can1 {
	status = "okay";
	compatible = "rockchip,canfd-1.0";
    //compatible = "rockchip,can-2.0";
	pinctrl-names = "default";
	pinctrl-0 = <&can1m1_pins>;
	assigned-clocks = <&cru CLK_CAN1>;
	assigned-clock-rates = <200000000>;
};

//=============================================================================
//      SUSPEND
//=============================================================================
//CHERCK_IT //NEED?
/*
&rockchip_suspend {
	compatible = "rockchip,pm-rk3588";
	status = "okay";
	rockchip,sleep-debug-en = <1>;
	rockchip,sleep-mode-config = <
		(0
		| RKPM_SLP_ARMOFF_DDRPD
		)
	>;
	rockchip,wakeup-config = <
		(0
		| RKPM_GPIO_WKUP_EN
		| RKPM_USB_WKUP_EN
		)
	>;
};
*/

//=============================================================================
//  OTHER
//=============================================================================
// watchdog
&wdt {
    status = "okay";
};

//CHECK_IT
&rkcif {
	status = "okay";
};

&rkcif_mmu {
	status = "okay";
};

&rkisp0 {
	status = "okay";
};

&isp0_mmu {
	status = "okay";
};

&rkisp1 {
	status = "okay";
};

&isp1_mmu {
	status = "okay";
};


//=============================================================================
//  GPIO NAMES
//=============================================================================
&gpio0 {
	gpio-line-names =
		/* GPIO0_A0-A3 */
		"", "", "", "",
		/* GPIO0_A4-A7 */
		"", "", "", "",

		/* GPIO0_B0-B3 */
		"CPU_CP_1V8_2", "", "", "",
		/* GPIO0_B4-B7 */
		"", "", "", "",

		/* GPIO0_C0-C3 */
		"", "", "", "",
		/* GPIO0_C4-C7 */
		"", "", "", "",

		/* GPIO0_D0-D3 */
		"CPU_CP_1V8_0", "", "", "CPU_CP_1V8_1",
		/* GPIO0_D4-D7 */
		"", "", "", "";
};

&gpio1 {
	gpio-line-names =
		/* GPIO1_A0-A3 */
		"", "", "", "M2kB_PCIE_CFG1",
		/* GPIO1_A4-A7 */
		"", "", "", "",

		/* GPIO1_B0-B3 */
		"", "", "", "",
		/* GPIO1_B4-B7 */
		"", "", "", "",

		/* GPIO1_C0-C3 */
		"", "", "", "",
		/* GPIO1_C4-C7 */
		"CPU_CP_1V8_3", "", "CPU_CP_1V8_4", "",

		/* GPIO1_D0-D3 */
		"", "", "", "",
		/* GPIO1_D4-D7 */
		"", "CPU_CP_1V8_5", "", "";
};

&gpio2 {
	gpio-line-names =
		/* GPIO2_A0-A3 */
		"", "", "", "",
		/* GPIO2_A4-A7 */
		"", "", "", "",

		/* GPIO2_B0-B3 */
		"", "", "", "",
		/* GPIO2_B4-B7 */
		"CPU_CP_1V8_6", "CPU_CP_1V8_7", "", "",

		/* GPIO2_C0-C3 */
		"", "", "", "",
		/* GPIO2_C4-C7 */
		"", "CPU_CP_1V8_8", "", "",

		/* GPIO2_D0-D3 */
		"", "", "", "",
		/* GPIO2_D4-D7 */
		"", "", "", "";
};

&gpio3 {
	gpio-line-names =
		/* GPIO3_A0-A3 */
		"", "", "", "",
		/* GPIO3_A4-A7 */
		"", "", "", "",

		/* GPIO3_B0-B3 */
		"", "", "", "",
		/* GPIO3_B4-B7 */
		"", "", "", "",

		/* GPIO3_C0-C3 */
		"CPU_USB30_OC_", "", "", "",
		/* GPIO3_C4-C7 */
		"", "", "", "",

		/* GPIO3_D0-D3 */
		"", "", "", "",
		/* GPIO3_D4-D7 */
		"", "", "", "";
};

&gpio4 {
	gpio-line-names =
		/* GPIO4_A0-A3 */
		"", "CPU_CP_1V8_10", "", "",
		/* GPIO4_A4-A7 */
		"", "", "WDT_DIS", "WDT_WDI",

		/* GPIO4_B0-B3 */
		"", "mPCIE_m2_SEL", "", "",
		/* GPIO4_B4-B7 */
		"", "", "", "",

		/* GPIO4_C0-C3 */
		"", "", "", "",
		/* GPIO4_C4-C7 */
		"", "", "CPU_CP_1V8_9", "",

		/* GPIO4_D0-D3 */
		"", "", "", "",
		/* GPIO4_D4-D7 */
		"", "", "", "";
};
