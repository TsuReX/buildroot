
/dts-v1/;
#include "atb-rk3568j-mpc.dts"

/ {
	compatible = "atb,atb-rk3568j-mpc", "rockchip,rk3568";
	model = "ATB-RK3568J-MPC";

	chosen: chosen {
		stdout-path = "serial8:115200n8";
		bootargs = "root=/dev/mmcblk1p2=rootfs rootfstype=ext4 ro rootwait";
	};
};
