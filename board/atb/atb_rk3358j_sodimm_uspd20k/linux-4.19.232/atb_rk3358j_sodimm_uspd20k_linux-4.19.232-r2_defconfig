## configs/atb_rk3568_mpc_m2_linux-5.10.160_defconfig
```kconfig
BR2_aarch64=y
BR2_cortex_a55=y
BR2_PACKAGE_HOST_LINUX_HEADERS_CUSTOM_5_10=y
BR2_BINUTILS_VERSION_2_39_X=y
BR2_TOOLCHAIN_BUILDROOT_CXX=y
BR2_WGET="wget --passive-ftp -nd -t 3 --no-check-certificate"
BR2_CCACHE=y
BR2_RELRO_NONE=y
BR2_TARGET_GENERIC_HOSTNAME="atb-rk3568-mpc-m"
BR2_TARGET_GENERIC_ISSUE="Welcome to ATB"
BR2_ROOTFS_DEVICE_CREATION_DYNAMIC_EUDEV=y
BR2_TARGET_GENERIC_ROOT_PASSWD="root"
BR2_SYSTEM_BIN_SH_BASH=y
BR2_TARGET_TZ_INFO=y
BR2_TARGET_LOCALTIME="Europe/Moscow"
BR2_LINUX_KERNEL=y
BR2_LINUX_KERNEL_CUSTOM_GIT=y
BR2_LINUX_KERNEL_CUSTOM_REPO_URL="https://github.com/armbian/linux-rockchip.git"
BR2_LINUX_KERNEL_CUSTOM_REPO_VERSION="linux-5.10-gen-rkr5.1"
BR2_LINUX_KERNEL_PATCH="board/atb/atb_rk3568_mpc_m2/linux_5_10_160/pmic-rk809.patch"
BR2_LINUX_KERNEL_USE_CUSTOM_CONFIG=y
BR2_LINUX_KERNEL_CUSTOM_CONFIG_FILE="board/atb/atb_rk3568_mpc_m2/linux_5_10_160/atb_rk3568_mpc_m2_linux-5.10.160_defconfig"
BR2_LINUX_KERNEL_DTS_SUPPORT=y
BR2_LINUX_KERNEL_CUSTOM_DTS_PATH="board/atb/atb_rk3568_mpc_m2/linux_5_10_160/atb-rk3568-mpc-m2.dts board/atb/atb_rk3568_mpc_m2/linux_5_10_160/atb-rk3568-mpc-m2-ethernet.dtsi board/atb/atb_rk3568_mpc_m2/linux_5_10_160/atb-rk3568-mpc-m2-pcie.dtsi board/atb/atb_rk3568_mpc_m2/linux_5_10_160/atb-rk3568-mpc-m2-power.dtsi board/atb/atb_rk3568_mpc_m2/linux_5_10_160/atb-rk3568-mpc-m2-usb.dtsi board/atb/atb_rk3568_mpc_m2/linux_5_10_160/atb-rk3568-mpc-m2-video.dtsi board/atb/atb_rk3568_mpc_m2/linux_5_10_160/atb-rk3568-mpc-m2-wireless.dtsi board/atb/atb_rk3568_mpc_m2/linux_5_10_160/rk3568-dram-default-timing.dtsi board/atb/atb_rk3568_mpc_m2/linux_5_10_160/rk3568-pinctrl.dtsi board/atb/atb_rk3568_mpc_m2/linux_5_10_160/rk3568.dtsi board/atb/atb_rk3568_mpc_m2/linux_5_10_160/rockchip-pinconf.dtsi"
BR2_PACKAGE_BUSYBOX_SHOW_OTHERS=y
BR2_PACKAGE_FAAD2=y
BR2_PACKAGE_MPG123=y
BR2_PACKAGE_SOX=y
BR2_PACKAGE_BROTLI=y
BR2_PACKAGE_GZIP=y
BR2_PACKAGE_LRZIP=y
BR2_PACKAGE_LZIP=y
BR2_PACKAGE_LZOP=y
BR2_PACKAGE_P7ZIP=y
BR2_PACKAGE_PIGZ=y
BR2_PACKAGE_PIXZ=y
BR2_PACKAGE_UNRAR=y
BR2_PACKAGE_UNZIP=y
BR2_PACKAGE_ZIP=y
BR2_PACKAGE_ZSTD=y
BR2_PACKAGE_DHRYSTONE=y
BR2_PACKAGE_STRACE=y
BR2_PACKAGE_STRESS=y
BR2_PACKAGE_STRESS_NG=y
BR2_PACKAGE_BINUTILS=y
BR2_PACKAGE_GREP=y
BR2_PACKAGE_E2FSPROGS=y
BR2_PACKAGE_E2FSPROGS_RESIZE2FS=y
BR2_PACKAGE_MMC_UTILS=y
BR2_PACKAGE_FB_TEST_APP=y
BR2_PACKAGE_FBSET=y
BR2_PACKAGE_FBTERM=y
BR2_PACKAGE_LINUX_FIRMWARE=y
BR2_PACKAGE_LINUX_FIRMWARE_QUALCOMM_9377_BT=y
BR2_PACKAGE_LINUX_FIRMWARE_RTL_87XX_BT=y
BR2_PACKAGE_LINUX_FIRMWARE_ATHEROS_10K_QCA9377=y
BR2_PACKAGE_LINUX_FIRMWARE_RTL_87XX=y
BR2_PACKAGE_EVTEST=y
BR2_PACKAGE_I2C_TOOLS=y
BR2_PACKAGE_MDIO_TOOLS=y
BR2_PACKAGE_MEMTESTER=y
BR2_PACKAGE_PCIUTILS=y
BR2_PACKAGE_SPI_TOOLS=y
BR2_PACKAGE_USBUTILS=y
BR2_PACKAGE_WIPE=y
BR2_PACKAGE_PERL=y
BR2_PACKAGE_PYTHON3=y
BR2_PACKAGE_LIBMAD=y
BR2_PACKAGE_CA_CERTIFICATES=y
BR2_PACKAGE_NETTLE=y
BR2_PACKAGE_SQLITE=y
BR2_PACKAGE_LIBGPIOD=y
BR2_PACKAGE_LIBGPIOD_TOOLS=y
BR2_PACKAGE_LIBINPUT=y
BR2_PACKAGE_LIBPCIACCESS=y
BR2_PACKAGE_LIBXKBCOMMON=y
BR2_PACKAGE_TSLIB=y
BR2_PACKAGE_LIBXML2=y
BR2_PACKAGE_LIBMPEG2=y
BR2_PACKAGE_LIBTHEORA=y
BR2_PACKAGE_LIBIDN2=y
BR2_PACKAGE_RTMPDUMP=y
BR2_PACKAGE_LIBPTHREAD_STUBS=y
BR2_PACKAGE_LIBTASN1=y
BR2_PACKAGE_LIBFRIBIDI=y
BR2_PACKAGE_PCRE2=y
BR2_PACKAGE_PCRE2_16=y
BR2_PACKAGE_SDL2_TEST_RENDER=y
BR2_PACKAGE_XUTIL_UTIL_MACROS=y
BR2_PACKAGE_AUTOSSH=y
BR2_PACKAGE_BLUEZ_TOOLS=y
BR2_PACKAGE_BLUEZ5_UTILS=y
BR2_PACKAGE_BLUEZ5_UTILS_CLIENT=y
BR2_PACKAGE_BLUEZ5_UTILS_MONITOR=y
BR2_PACKAGE_BLUEZ5_UTILS_TOOLS=y
BR2_PACKAGE_CAN_UTILS=y
BR2_PACKAGE_CONNMAN=y
BR2_PACKAGE_CONNMAN_WIFI=y
BR2_PACKAGE_CONNMAN_BLUETOOTH=y
BR2_PACKAGE_DHCP=y
BR2_PACKAGE_DHCP_CLIENT=y
BR2_PACKAGE_DNSMASQ=y
BR2_PACKAGE_DROPBEAR=y
BR2_PACKAGE_ETHTOOL=y
BR2_PACKAGE_HOSTAPD=y
BR2_PACKAGE_IFPLUGD=y
BR2_PACKAGE_IFUPDOWN=y
BR2_PACKAGE_IPERF=y
BR2_PACKAGE_IPERF3=y
BR2_PACKAGE_IPROUTE2=y
BR2_PACKAGE_IPUTILS=y
BR2_PACKAGE_LRZSZ=y
BR2_PACKAGE_NETCAT=y
BR2_PACKAGE_NLOAD=y
BR2_PACKAGE_NTP=y
BR2_PACKAGE_NUTTCP=y
BR2_PACKAGE_OPENSSH=y
BR2_PACKAGE_PHYTOOL=y
BR2_PACKAGE_TCPDUMP=y
BR2_PACKAGE_TCPDUMP_SMB=y
BR2_PACKAGE_WIRELESS_REGDB=y
BR2_PACKAGE_WIRELESS_TOOLS=y
BR2_PACKAGE_WIRELESS_TOOLS_LIB=y
BR2_PACKAGE_WPA_SUPPLICANT_AUTOSCAN=y
BR2_PACKAGE_WPA_SUPPLICANT_EAP=y
BR2_PACKAGE_WPA_SUPPLICANT_CLI=y
BR2_PACKAGE_WPA_SUPPLICANT_WPA_CLIENT_SO=y
BR2_PACKAGE_WPA_SUPPLICANT_PASSPHRASE=y
BR2_PACKAGE_FILE=y
BR2_PACKAGE_LOCKFILE_PROGS=y
BR2_PACKAGE_ATTR=y
BR2_PACKAGE_HTOP=y
BR2_PACKAGE_KEYUTILS=y
BR2_PACKAGE_NUMACTL=y
BR2_PACKAGE_PROCPS_NG=y
BR2_PACKAGE_PROCRANK_LINUX=y
BR2_PACKAGE_TAR=y
BR2_PACKAGE_UTIL_LINUX_BINARIES=y
BR2_PACKAGE_UTIL_LINUX_MOUNT=y
BR2_PACKAGE_UTIL_LINUX_RFKILL=y
BR2_PACKAGE_UTIL_LINUX_WIPEFS=y
BR2_PACKAGE_MC=y
BR2_PACKAGE_NANO=y
BR2_TARGET_ROOTFS_CPIO=y
BR2_TARGET_ROOTFS_CPIO_GZIP=y
BR2_TARGET_UBOOT=y
BR2_TARGET_UBOOT_BUILD_SYSTEM_KCONFIG=y
BR2_TARGET_UBOOT_CUSTOM_GIT=y
BR2_TARGET_UBOOT_CUSTOM_REPO_URL="https://git1.atb-e.ru/cpu_soft/uboot/denx-uboot.git"
BR2_TARGET_UBOOT_CUSTOM_REPO_VERSION="denx_ok_r2"
BR2_TARGET_UBOOT_BOARD_DEFCONFIG="atb_rk3568_mpc_m"
BR2_TARGET_UBOOT_NEEDS_PYELFTOOLS=y
# BR2_TARGET_UBOOT_FORMAT_BIN is not set
BR2_TARGET_UBOOT_FORMAT_CUSTOM=y
BR2_TARGET_UBOOT_FORMAT_CUSTOM_NAME="idbloader.img u-boot.itb"
BR2_TARGET_UBOOT_CUSTOM_MAKEOPTS="BL31=$(TOPDIR)/board/atb/atb_rk3568_mpc_m2/uboot/rk3568_bl31_v1.43.elf ROCKCHIP_TPL=$(TOPDIR)/board/atb/atb_rk3568_mpc_m2/uboot/rk3568_ddr_1560MHz_v1.18.bin"
BR2_PACKAGE_HOST_E2FSPROGS=y
BR2_PACKAGE_HOST_GENIMAGE=y
```

## configs/atb_rk3568j_mpc_denx_linux-5.10.110_defconfig
```kconfig
BR2_aarch64=y
BR2_cortex_a55=y
BR2_PACKAGE_HOST_LINUX_HEADERS_CUSTOM_5_10=y
BR2_BINUTILS_VERSION_2_39_X=y
BR2_TOOLCHAIN_BUILDROOT_CXX=y
BR2_WGET="wget --passive-ftp -nd -t 3 --no-check-certificate"
BR2_CCACHE=y
BR2_RELRO_NONE=y
BR2_TARGET_GENERIC_HOSTNAME="atb-rk3568j-mpc"
BR2_TARGET_GENERIC_ISSUE="Welcome to ATB"
BR2_ROOTFS_DEVICE_CREATION_DYNAMIC_EUDEV=y
BR2_TARGET_GENERIC_ROOT_PASSWD="root"
BR2_SYSTEM_BIN_SH_BASH=y
BR2_TARGET_TZ_INFO=y
BR2_ROOTFS_OVERLAY="board/atb/atb_rk3568j_mpc/overlay"
BR2_LINUX_KERNEL=y
BR2_LINUX_KERNEL_CUSTOM_GIT=y
BR2_LINUX_KERNEL_CUSTOM_REPO_URL="https://git1.atb-e.ru/cpu_soft/cores/kernel-rockchip.git"
BR2_LINUX_KERNEL_CUSTOM_REPO_VERSION="ok_r1"
BR2_LINUX_KERNEL_USE_CUSTOM_CONFIG=y
BR2_LINUX_KERNEL_CUSTOM_CONFIG_FILE="board/atb/atb_rk3568j_mpc/linux-5.10.110/atb_rk3568j_mpc_linux-5.10.110_defconfig"
BR2_LINUX_KERNEL_DTS_SUPPORT=y
BR2_LINUX_KERNEL_CUSTOM_DTS_PATH="board/atb/atb_rk3568j_mpc/linux-5.10.110/atb-rk3568j-mpc.dts board/atb/atb_rk3568j_mpc/linux-5.10.110/rk3568.dtsi board/atb/atb_rk3568j_mpc/linux-5.10.110/rk3568-dram-default-timing.dtsi board/atb/atb_rk3568j_mpc/linux-5.10.110/rockchip-pinconf.dtsi board/atb/atb_rk3568j_mpc/linux-5.10.110/rk3568-pinctrl.dtsi board/atb/atb_rk3568j_mpc/linux-5.10.110/ethernet-mpc.dtsi board/atb/atb_rk3568j_mpc/linux-5.10.110/pcie-mpc.dtsi board/atb/atb_rk3568j_mpc/linux-5.10.110/usb-sata-pcie-mpc.dtsi board/atb/atb_rk3568j_mpc/linux-5.10.110/video-mpc.dtsi board/atb/atb_rk3568j_mpc/linux-5.10.110/wireless-mpc.dtsi board/atb/atb_rk3568j_mpc/linux-5.10.110/canfd-mpc.dtsi board/atb/atb_rk3568j_mpc/linux-5.10.110/audio-mpc.dtsi"
BR2_PACKAGE_BUSYBOX_SHOW_OTHERS=y
BR2_PACKAGE_ALSA_UTILS=y
BR2_PACKAGE_ALSA_UTILS_ALSACONF=y
BR2_PACKAGE_ALSA_UTILS_ACONNECT=y
BR2_PACKAGE_ALSA_UTILS_ALSALOOP=y
BR2_PACKAGE_ALSA_UTILS_AMIXER=y
BR2_PACKAGE_ALSA_UTILS_APLAY=y
BR2_PACKAGE_ALSA_UTILS_SPEAKER_TEST=y
BR2_PACKAGE_FAAD2=y
BR2_PACKAGE_MPG123=y
BR2_PACKAGE_SOX=y
BR2_PACKAGE_DHRYSTONE=y
BR2_PACKAGE_FIO=y
BR2_PACKAGE_STRACE=y
BR2_PACKAGE_STRESS=y
BR2_PACKAGE_STRESS_NG=y
BR2_PACKAGE_BINUTILS=y
BR2_PACKAGE_GREP=y
BR2_PACKAGE_E2FSPROGS=y
BR2_PACKAGE_E2FSPROGS_RESIZE2FS=y
BR2_PACKAGE_MMC_UTILS=y
BR2_PACKAGE_BITSTREAM_VERA=y
BR2_PACKAGE_CANTARELL=y
BR2_PACKAGE_DEJAVU=y
BR2_PACKAGE_FONT_AWESOME=y
BR2_PACKAGE_GHOSTSCRIPT_FONTS=y
BR2_PACKAGE_INCONSOLATA=y
BR2_PACKAGE_HICOLOR_ICON_THEME=y
BR2_PACKAGE_GLMARK2=y
BR2_PACKAGE_FBTERM=y
BR2_PACKAGE_MESA3D=y
BR2_PACKAGE_MESA3D_GALLIUM_DRIVER_PANFROST=y
BR2_PACKAGE_MESA3D_OPENGL_EGL=y
BR2_PACKAGE_MESA3D_OPENGL_ES=y
BR2_PACKAGE_SDL2_KMSDRM=y
BR2_PACKAGE_LINUX_FIRMWARE=y
BR2_PACKAGE_LINUX_FIRMWARE_ATHEROS_10K_QCA9377=y
BR2_PACKAGE_LINUX_FIRMWARE_ATHEROS_10K_QCA998X=y
BR2_PACKAGE_LINUX_FIRMWARE_IWLWIFI_22000=y
BR2_PACKAGE_LINUX_FIRMWARE_IWLWIFI_22260=y
BR2_PACKAGE_LINUX_FIRMWARE_IWLWIFI_3160=y
BR2_PACKAGE_LINUX_FIRMWARE_IWLWIFI_3168=y
BR2_PACKAGE_LINUX_FIRMWARE_IWLWIFI_3945=y
BR2_PACKAGE_LINUX_FIRMWARE_IWLWIFI_4965=y
BR2_PACKAGE_LINUX_FIRMWARE_IWLWIFI_5000=y
BR2_PACKAGE_LINUX_FIRMWARE_IWLWIFI_6000G2A=y
BR2_PACKAGE_LINUX_FIRMWARE_IWLWIFI_6000G2B=y
BR2_PACKAGE_LINUX_FIRMWARE_IWLWIFI_7260=y
BR2_PACKAGE_LINUX_FIRMWARE_IWLWIFI_7265D=y
BR2_PACKAGE_LINUX_FIRMWARE_IWLWIFI_8000C=y
BR2_PACKAGE_LINUX_FIRMWARE_IWLWIFI_8265=y
BR2_PACKAGE_LINUX_FIRMWARE_IWLWIFI_9XXX=y
BR2_PACKAGE_LINUX_FIRMWARE_RTL_81XX=y
BR2_PACKAGE_LINUX_FIRMWARE_RTL_87XX=y
BR2_PACKAGE_LINUX_FIRMWARE_RTL_88XX=y
BR2_PACKAGE_LINUX_FIRMWARE_RTL_RTW88=y
BR2_PACKAGE_DBUS=y
BR2_PACKAGE_EVTEST=y
BR2_PACKAGE_I2C_TOOLS=y
BR2_PACKAGE_MDIO_TOOLS=y
BR2_PACKAGE_MEMTESTER=y
BR2_PACKAGE_PCIUTILS=y
BR2_PACKAGE_SPI_TOOLS=y
BR2_PACKAGE_USBUTILS=y
BR2_PACKAGE_WIPE=y
BR2_PACKAGE_PERL=y
BR2_PACKAGE_PYTHON3=y
BR2_PACKAGE_PYTHON_PYELFTOOLS=y
BR2_PACKAGE_LIBMAD=y
BR2_PACKAGE_CA_CERTIFICATES=y
BR2_PACKAGE_NETTLE=y
BR2_PACKAGE_SQLITE=y
BR2_PACKAGE_LIBAIO=y
BR2_PACKAGE_LIBGPIOD=y
BR2_PACKAGE_LIBGPIOD_TOOLS=y
BR2_PACKAGE_LIBINPUT=y
BR2_PACKAGE_LIBXKBCOMMON=y
BR2_PACKAGE_TSLIB=y
BR2_PACKAGE_LIBXML2=y
BR2_PACKAGE_LIBMPEG2=y
BR2_PACKAGE_LIBTHEORA=y
BR2_PACKAGE_LIBIDN2=y
BR2_PACKAGE_RTMPDUMP=y
BR2_PACKAGE_LIBTASN1=y
BR2_PACKAGE_LIBFRIBIDI=y
BR2_PACKAGE_PCRE2=y
BR2_PACKAGE_PCRE2_16=y
BR2_PACKAGE_EEUPDATEARM=y
BR2_PACKAGE_SDL2_TEST_RENDER=y
BR2_PACKAGE_XUTIL_UTIL_MACROS=y
BR2_PACKAGE_AUTOSSH=y
BR2_PACKAGE_CAN_UTILS=y
BR2_PACKAGE_DHCP=y
BR2_PACKAGE_DHCP_CLIENT=y
BR2_PACKAGE_DNSMASQ=y
BR2_PACKAGE_DROPBEAR=y
# BR2_PACKAGE_DROPBEAR_CLIENT is not set
BR2_PACKAGE_ETHTOOL=y
BR2_PACKAGE_HOSTAPD=y
BR2_PACKAGE_IFPLUGD=y
BR2_PACKAGE_IFUPDOWN=y
BR2_PACKAGE_IPERF=y
BR2_PACKAGE_IPERF3=y
BR2_PACKAGE_IPROUTE2=y
BR2_PACKAGE_IPUTILS=y
BR2_PACKAGE_LRZSZ=y
BR2_PACKAGE_NETCAT=y
BR2_PACKAGE_NLOAD=y
BR2_PACKAGE_NTP=y
BR2_PACKAGE_NUTTCP=y
BR2_PACKAGE_OPENSSH=y
BR2_PACKAGE_PHYTOOL=y
BR2_PACKAGE_TCPDUMP=y
BR2_PACKAGE_TCPDUMP_SMB=y
BR2_PACKAGE_WIRELESS_REGDB=y
BR2_PACKAGE_WIRELESS_TOOLS=y
BR2_PACKAGE_WIRELESS_TOOLS_LIB=y
BR2_PACKAGE_WPA_SUPPLICANT=y
BR2_PACKAGE_WPA_SUPPLICANT_AUTOSCAN=y
BR2_PACKAGE_WPA_SUPPLICANT_EAP=y
BR2_PACKAGE_WPA_SUPPLICANT_CLI=y
BR2_PACKAGE_WPA_SUPPLICANT_WPA_CLIENT_SO=y
BR2_PACKAGE_WPA_SUPPLICANT_PASSPHRASE=y
BR2_PACKAGE_LOCKFILE_PROGS=y
BR2_PACKAGE_ATTR=y
BR2_PACKAGE_KEYUTILS=y
BR2_PACKAGE_NUMACTL=y
BR2_PACKAGE_PROCPS_NG=y
BR2_PACKAGE_PROCRANK_LINUX=y
BR2_PACKAGE_UTIL_LINUX_BINARIES=y
BR2_PACKAGE_UTIL_LINUX_MOUNT=y
BR2_PACKAGE_UTIL_LINUX_WIPEFS=y
BR2_PACKAGE_MC=y
BR2_PACKAGE_NANO=y
BR2_TARGET_ROOTFS_CPIO=y
BR2_TARGET_ROOTFS_CPIO_GZIP=y
# BR2_TARGET_ROOTFS_TAR is not set
BR2_TARGET_UBOOT=y
BR2_TARGET_UBOOT_BUILD_SYSTEM_KCONFIG=y
BR2_TARGET_UBOOT_CUSTOM_GIT=y
BR2_TARGET_UBOOT_CUSTOM_REPO_URL="https://github.com/u-boot/u-boot.git"
BR2_TARGET_UBOOT_CUSTOM_REPO_VERSION="v2024.01"
BR2_TARGET_UBOOT_PATCH="board/atb/atb_rk3568j_mpc/uboot/add-atb-rk3568j-mpc.patch"
BR2_TARGET_UBOOT_USE_CUSTOM_CONFIG=y
BR2_TARGET_UBOOT_CUSTOM_CONFIG_FILE="board/atb/atb_rk3568j_mpc/uboot/atb_rk3568j_mpc_v2024.01_defconfig"
BR2_TARGET_UBOOT_NEEDS_PYELFTOOLS=y
# BR2_TARGET_UBOOT_FORMAT_BIN is not set
BR2_TARGET_UBOOT_FORMAT_CUSTOM=y
BR2_TARGET_UBOOT_FORMAT_CUSTOM_NAME="idbloader.img u-boot.itb"
BR2_TARGET_UBOOT_CUSTOM_MAKEOPTS="BL31=$(TOPDIR)/board/atb/atb_rk3568j_mpc/uboot/rk3568_bl31_v1.43.elf ROCKCHIP_TPL=$(TOPDIR)/board/atb/atb_rk3568j_mpc/uboot/rk3568_ddr_1560MHz_v1.18.bin"
BR2_PACKAGE_HOST_E2FSPROGS=y
BR2_PACKAGE_HOST_GENIMAGE=y
BR2_PACKAGE_HOST_UBOOT_TOOLS=y
```
