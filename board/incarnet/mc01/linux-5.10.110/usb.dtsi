/{

/*
	USB2_HOST2
*/

/*
	This controller is connected to X5 upper port
*/
&usb_host0_ehci {
	status = "okay";
};

/*
	This controller is connected to X5 upper port
*/
&usb_host0_ohci {
	status = "okay";
};

&u2phy0_host {
	status = "okay";
};

&u2phy0_otg {
	status = "okay";
};

&usb2phy0 {
	status = "okay";
};

/*
	USB2_HOST3
*/

/*
	This controller is connected to X5 lower port
*/
&usb_host1_ehci {
	status = "okay";
};

/*
	This controller is connected to X5 lower port
*/
&usb_host1_ohci {
	status = "okay";
};


&u2phy1_host {
	status = "okay";
};


&u2phy1_otg {
	status = "okay";
};

&usb2phy1 {
	status = "okay";
};

/*
	USB3_OTG0 or SATA0
*/
// X4
&usbdrd_dwc3 {
	dr_mode = "host";
	// If this controller is enabled, sata0 must be disabled
	status = "okay";
};

&usbdrd30 {
	status = "okay";
};

&sata0 {
//	If this controller is enabled, usbdrd_dwc3 must be disabled
	status = "disabled";
};

&combphy0_us {
//	This controller is phy for usbdrd_dwc3 and sata0 controllers
	status = "okay";
};

/*
	USB3_HOST1 or SATA1
*/

/*
	Signals form usbhost_dwc3 and sata1 controllers controllers go through D12(switch)(EXT_SATA_EN) and D10(switch)(M2_USB3.0_EN) to X14(m.2B) or X16(SATA).
	To supply X16(SATA) with signals from SATA1 it needs to set EXT_SATA_EN=1 (+3.3v) and disable usbhost_dwc3 controller.
	To supply X14(m.2B) with signals from SATA1 it needs to set EXT_SATA_EN=0 (GND) and disable usbhost_dwc3 controller.
	To supply X14(m.2B) with signals from USB3_HOS1 it needs to set EXT_SATA_EN=0 (GND), M2_USB3.0_EN=1 (+3.3v) and disable sata1 controller.
	By defaults M2_USB3.0_EN signal is pulled down via R161 and EXT_SATA_EN signal is pulled down via R165 and can be pulled up via X17.
*/
&usbhost_dwc3 {
	// If this controller is enabled, sata1 must be disabled
	status = "ok";
};

&usbhost30 {
	status = "ok";
};

// This controller is phy for usbhost_dwc3 and sata1 controllers
&combphy1_usq {
	status = "okay";
};
